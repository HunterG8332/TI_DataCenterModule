## firmware/BMC_firm/components/bmc_app/Kconfig.projbuild
```kconfig
menu "BMC application"

    config BMC_TEST_HOOKS
        bool "Enable validation test hooks (TESTSET / TESTINJECT commands)"
        default y
        help
            Lets the host lower the over-temperature limit and force fault
            conditions, which the validation plan needs (FSR 3.2.5.1.2 and
            3.2.5.1.3). The limit can only be lowered, never raised above 120 C,
            and every record carries a flag while the hooks are compiled in.
            Turn this OFF for the final demonstration build.

    config BMC_INLET_SENSOR
        bool "A second TMP117 measures inlet (ambient) air"
        default n
        help
            Adds the inlet temperature to telemetry and the self-test and uses
            it for the "start from ambient" check before a profile run.

    config BMC_INLET_I2C_ADDR
        hex "I2C address of the inlet TMP117"
        depends on BMC_INLET_SENSOR
        default 0x49

endmenu
```

## firmware/BMC_firm/components/bmc_net/Kconfig.projbuild
```kconfig
menu "BMC network"

    config BMC_NET_SSID
        string "SoftAP SSID"
        default "BMC-Telemetry"

    config BMC_NET_PASSWORD
        string "SoftAP WPA2 password (8+ characters; empty = open network)"
        default "bmctelemetry"
        help
            Change this for anything beyond bench use. Note sdkconfig is tracked in git.

    config BMC_NET_CHANNEL
        int "SoftAP 2.4 GHz channel"
        range 1 13
        default 1

    config BMC_NET_MAX_STATIONS
        int "Maximum simultaneous Wi-Fi clients"
        range 1 10
        default 4

endmenu
```

## firmware/BMC_firm/components/bmc_stream/Kconfig.projbuild
```kconfig
menu "BMC telemetry stream"

    config BMC_STREAM_PORT
        int "UDP port (BMC listens for HELLO here and streams from here)"
        range 1024 65535
        default 9000

    config BMC_STREAM_ID
        string "bmc_id field of every record"
        default "bmc0"

endmenu
```
